	.db	0, 0, 0, 0, 0, 0, 0, 0, 0, 0, 0, 0, 0, 0, 0, 0, 0, 0, 0, 0, 0, 0, 0, 0, 0, 0, 0, 0, 0, 0, 0, 0, 176, 255, 193, 254, 7, 0, 0, 0, 0, 0, 0, 0, 0, 0	;33
	.db	0, 192, 0, 48, 7, 128, 31, 0, 60, 0, 0, 0, 0, 3, 192, 28, 0, 126, 0, 240, 0, 0, 0, 0, 0, 0, 134, 1, 254, 31, 248, 127, 128, 97, 0, 134, 1, 254, 31, 248, 127, 128, 97, 0, 0, 0	;35
	.db	0, 0, 128, 227, 0, 199, 15, 12, 49, 248, 255, 225, 255, 7, 35, 14, 248, 28, 192, 57, 0, 0, 0, 0, 0, 128, 0, 3, 14, 30, 240, 120, 0, 207, 0, 243, 0, 30, 15, 120, 112, 192, 0, 1, 0, 0	;37
	.db	0, 0, 128, 15, 0, 127, 0, 134, 27, 24, 252, 96, 124, 6, 255, 25, 60, 124, 216, 240, 32, 6, 0, 0, 0, 0, 0, 3, 192, 28, 0, 126, 0, 240, 0, 0, 0, 0, 0, 0, 0, 0, 0, 0, 0, 0	;39
	.db	0, 0, 0, 0, 0, 0, 0, 224, 7, 224, 127, 192, 129, 131, 1, 24, 2, 64, 0, 0, 0, 0, 0, 0, 0, 0, 0, 128, 0, 16, 6, 96, 112, 224, 128, 255, 1, 248, 1, 0, 0, 0, 0, 0, 0, 0	;41
	.db	0, 0, 0, 214, 0, 240, 1, 128, 3, 192, 127, 0, 255, 1, 224, 0, 192, 7, 128, 53, 0, 0, 0, 0, 0, 0, 24, 0, 96, 0, 128, 1, 224, 127, 128, 255, 1, 96, 0, 128, 1, 0, 6, 0, 0, 0	;43
	.db	0, 0, 140, 1, 96, 14, 0, 63, 0, 120, 0, 0, 0, 0, 0, 0, 0, 0, 0, 0, 0, 0, 0, 0, 0, 0, 12, 0, 48, 0, 192, 0, 0, 3, 0, 12, 0, 48, 0, 192, 0, 0, 3, 0, 0, 0	;45
	.db	0, 0, 0, 0, 0, 3, 0, 30, 0, 120, 0, 192, 0, 0, 0, 0, 0, 0, 0, 0, 0, 0, 0, 0, 0, 96, 0, 128, 7, 0, 120, 0, 128, 7, 0, 120, 0, 128, 7, 0, 120, 0, 128, 1, 0, 0	;47
	.db	0, 0, 0, 255, 0, 255, 7, 46, 32, 24, 131, 97, 48, 6, 1, 29, 248, 63, 128, 63, 0, 0, 0, 0, 0, 32, 64, 128, 0, 3, 2, 24, 248, 255, 224, 255, 135, 0, 0, 2, 0, 8, 0, 0, 0, 0	;49
	.db	0, 0, 96, 128, 129, 3, 12, 30, 96, 216, 128, 97, 14, 134, 113, 28, 6, 63, 56, 120, 0, 0, 0, 0, 0, 128, 1, 1, 3, 8, 6, 96, 24, 132, 97, 120, 135, 241, 15, 252, 28, 224, 0, 0, 0, 0	;51
	.db	192, 3, 0, 63, 0, 204, 3, 48, 28, 192, 192, 224, 255, 135, 255, 31, 48, 0, 192, 0, 0, 0, 0, 0, 0, 192, 112, 128, 193, 7, 2, 122, 8, 136, 33, 48, 134, 225, 24, 252, 97, 224, 3, 0, 0, 0	;53
	.db	0, 0, 128, 63, 0, 255, 3, 206, 28, 24, 198, 96, 24, 6, 113, 16, 248, 0, 192, 1, 0, 0, 0, 0, 0, 0, 0, 129, 1, 12, 30, 96, 224, 129, 1, 30, 6, 224, 25, 0, 126, 0, 224, 1, 0, 0	;55
	.db	0, 0, 128, 131, 1, 31, 15, 134, 70, 8, 12, 33, 24, 132, 176, 24, 124, 60, 224, 96, 0, 0, 0, 0, 0, 0, 240, 0, 224, 7, 193, 33, 12, 3, 97, 8, 6, 71, 28, 248, 63, 128, 127, 0, 0, 0	;57
	.db	0, 0, 0, 0, 0, 134, 1, 60, 15, 240, 60, 128, 97, 0, 0, 0, 0, 0, 0, 0, 0, 0, 0, 0, 0, 0, 0, 48, 99, 128, 221, 3, 124, 15, 224, 24, 0, 0, 0, 0, 0, 0, 0, 0, 0, 0	;59
	.db	0, 0, 0, 24, 0, 240, 0, 96, 6, 192, 48, 128, 129, 1, 3, 12, 4, 32, 0, 0, 0, 0, 0, 0, 0, 0, 51, 0, 204, 0, 48, 3, 192, 12, 0, 51, 0, 204, 0, 48, 3, 192, 12, 0, 0, 0	;61
	.db	0, 0, 0, 0, 0, 1, 8, 12, 48, 96, 96, 0, 195, 0, 152, 1, 192, 3, 0, 6, 0, 0, 0, 0, 0, 0, 0, 0, 0, 6, 0, 48, 152, 193, 97, 30, 6, 224, 28, 0, 62, 0, 112, 0, 0, 0	;63
	.db	0, 0, 0, 127, 0, 255, 7, 12, 24, 152, 207, 96, 126, 131, 9, 12, 238, 31, 176, 63, 0, 0, 0, 8, 0, 224, 1, 128, 63, 0, 226, 7, 0, 125, 0, 132, 7, 144, 7, 242, 7, 248, 7, 224, 0, 0	;65
	.db	8, 0, 225, 255, 135, 255, 31, 2, 65, 8, 4, 33, 48, 132, 225, 15, 252, 28, 224, 1, 0, 0, 0, 0, 0, 0, 126, 0, 254, 7, 12, 32, 24, 0, 33, 0, 132, 0, 16, 4, 96, 32, 192, 0, 0, 0	;67
	.db	8, 0, 225, 255, 135, 255, 31, 2, 64, 8, 0, 65, 0, 6, 1, 12, 248, 63, 192, 63, 0, 0, 0, 0, 0, 32, 0, 132, 255, 31, 254, 127, 8, 4, 33, 16, 132, 64, 16, 130, 67, 56, 192, 1, 0, 0	;69
	.db	0, 0, 32, 0, 132, 255, 31, 254, 127, 8, 4, 1, 16, 4, 64, 16, 128, 67, 0, 192, 1, 0, 0, 0, 0, 0, 126, 0, 254, 7, 12, 32, 24, 0, 33, 4, 132, 16, 16, 124, 96, 240, 193, 0, 4, 0	;71
	.db	8, 0, 225, 255, 135, 255, 31, 2, 65, 0, 4, 0, 16, 128, 64, 16, 254, 127, 248, 255, 33, 0, 4, 0, 0, 0, 0, 128, 0, 16, 2, 64, 248, 255, 225, 255, 135, 0, 16, 2, 64, 0, 0, 0, 0, 0	;73
	.db	0, 0, 24, 0, 96, 0, 16, 1, 64, 248, 255, 193, 255, 7, 0, 16, 0, 64, 0, 0, 0, 0, 0, 8, 0, 225, 255, 135, 255, 31, 194, 71, 128, 51, 0, 131, 1, 6, 12, 12, 96, 24, 0, 33, 0, 0	;75
	.db	0, 0, 32, 0, 132, 255, 31, 254, 127, 8, 0, 33, 0, 128, 0, 0, 2, 0, 56, 0, 0, 0, 0, 8, 0, 225, 255, 135, 255, 31, 2, 24, 0, 24, 0, 96, 128, 0, 6, 254, 63, 248, 255, 33, 0, 4	;77
	.db	8, 0, 225, 255, 135, 255, 31, 2, 78, 0, 30, 0, 30, 128, 28, 16, 254, 127, 248, 255, 33, 0, 4, 0, 0, 0, 126, 0, 254, 7, 12, 32, 24, 0, 33, 0, 6, 1, 12, 248, 63, 128, 63, 0, 0, 0	;79
	.db	8, 0, 225, 255, 135, 255, 31, 2, 65, 0, 4, 1, 16, 4, 192, 24, 0, 62, 0, 112, 0, 0, 0, 0, 0, 0, 124, 64, 252, 7, 58, 32, 120, 0, 241, 0, 228, 6, 156, 240, 63, 130, 63, 0, 0, 0	;81
	.db	8, 0, 225, 255, 135, 255, 31, 130, 65, 128, 7, 1, 23, 4, 78, 24, 28, 62, 56, 112, 96, 0, 0, 0, 0, 192, 192, 129, 129, 15, 2, 99, 8, 6, 33, 12, 132, 25, 16, 60, 96, 96, 192, 0, 0, 0	;83
	.db	0, 0, 0, 0, 134, 0, 16, 2, 64, 248, 255, 225, 255, 135, 0, 16, 2, 64, 0, 128, 1, 0, 0, 0, 0, 129, 255, 7, 255, 31, 14, 64, 24, 0, 96, 0, 128, 3, 16, 252, 127, 192, 255, 1, 0, 4	;85
	.db	0, 128, 1, 192, 7, 224, 23, 240, 3, 248, 0, 224, 3, 0, 252, 0, 128, 95, 0, 240, 1, 0, 6, 0, 240, 1, 254, 135, 255, 17, 126, 0, 0, 7, 0, 30, 128, 31, 0, 254, 67, 0, 255, 1, 192, 7	;87
	.db	8, 0, 225, 0, 135, 159, 31, 242, 79, 0, 6, 32, 255, 132, 159, 31, 14, 112, 8, 0, 1, 0, 0, 0, 0, 1, 0, 7, 0, 31, 2, 78, 248, 15, 224, 63, 128, 128, 19, 0, 124, 0, 192, 1, 0, 4	;89
	.db	0, 0, 0, 0, 128, 3, 24, 62, 64, 200, 3, 33, 60, 132, 192, 19, 2, 124, 24, 192, 1, 0, 0, 0, 0, 0, 0, 0, 0, 0, 255, 127, 252, 255, 49, 0, 198, 0, 24, 3, 96, 0, 0, 0, 0, 0	;91
	.db	0, 0, 1, 0, 7, 0, 15, 0, 15, 0, 15, 0, 15, 0, 15, 0, 15, 0, 14, 0, 8, 0, 0, 0, 0, 0, 0, 192, 0, 24, 3, 96, 12, 128, 241, 255, 199, 255, 31, 0, 0, 0, 0, 0, 0, 0	;93
	.db	0, 0, 0, 128, 0, 0, 6, 0, 48, 0, 128, 1, 0, 6, 0, 12, 0, 24, 0, 32, 0, 0, 0, 6, 0, 24, 0, 96, 0, 128, 1, 0, 6, 0, 24, 0, 96, 0, 128, 1, 0, 6, 0, 24, 0, 0	;95
	.db	0, 0, 0, 0, 0, 0, 0, 0, 60, 0, 248, 1, 224, 12, 0, 3, 0, 0, 0, 0, 0, 0, 0, 0, 0, 192, 3, 128, 223, 0, 70, 6, 8, 17, 32, 72, 0, 33, 1, 254, 7, 248, 15, 32, 0, 0	;97
	.db	0, 128, 224, 255, 7, 255, 63, 12, 1, 24, 8, 32, 96, 128, 193, 1, 252, 3, 224, 7, 0, 0, 0, 0, 0, 128, 15, 0, 255, 0, 14, 6, 8, 16, 32, 96, 128, 193, 1, 12, 3, 0, 0, 0, 0, 0	;99
	.db	0, 0, 128, 15, 0, 255, 0, 14, 2, 8, 16, 64, 96, 0, 194, 16, 254, 255, 248, 255, 35, 0, 0, 0, 0, 0, 31, 0, 254, 0, 76, 2, 24, 17, 32, 68, 128, 144, 0, 196, 3, 16, 7, 0, 0, 0	;101
	.db	0, 0, 0, 16, 128, 64, 0, 254, 31, 248, 255, 33, 16, 8, 64, 32, 0, 225, 0, 128, 1, 0, 0, 0, 0, 152, 25, 176, 255, 192, 108, 6, 179, 16, 204, 102, 48, 243, 128, 142, 3, 28, 24, 0, 0, 0	;103
	.db	0, 0, 32, 0, 130, 255, 31, 254, 255, 8, 8, 0, 64, 128, 128, 1, 254, 7, 248, 15, 32, 0, 0, 0, 0, 0, 0, 128, 0, 1, 2, 4, 248, 159, 225, 127, 134, 0, 0, 2, 0, 0, 0, 0, 0, 0	;105
	.db	0, 0, 112, 0, 224, 0, 192, 1, 0, 3, 0, 12, 64, 32, 0, 129, 255, 103, 252, 159, 1, 0, 0, 8, 0, 225, 255, 143, 255, 63, 226, 0, 224, 6, 192, 49, 128, 131, 1, 6, 4, 8, 16, 0, 0, 0	;107
	.db	0, 0, 0, 0, 128, 0, 32, 2, 128, 248, 255, 227, 255, 143, 0, 0, 2, 0, 0, 0, 0, 0, 0, 8, 16, 224, 127, 128, 255, 0, 0, 4, 248, 31, 224, 63, 0, 0, 1, 254, 7, 248, 31, 32, 0, 0	;109
	.db	0, 0, 32, 96, 128, 255, 1, 254, 3, 8, 24, 0, 64, 128, 128, 1, 254, 7, 248, 15, 32, 0, 0, 224, 7, 192, 63, 128, 131, 1, 6, 4, 8, 16, 32, 96, 0, 193, 0, 252, 1, 224, 3, 0, 0, 0	;111
	.db	1, 16, 252, 127, 240, 255, 64, 14, 6, 24, 16, 32, 96, 128, 193, 1, 252, 1, 224, 3, 0, 0, 0, 0, 0, 128, 15, 0, 127, 0, 14, 3, 24, 24, 32, 64, 144, 193, 193, 255, 3, 255, 31, 4, 64, 0	;113
	.db	0, 0, 32, 64, 128, 255, 1, 254, 7, 8, 4, 0, 32, 0, 0, 1, 0, 7, 0, 12, 0, 0, 0, 0, 0, 224, 56, 128, 241, 1, 194, 4, 136, 17, 32, 67, 128, 143, 1, 28, 7, 0, 0, 0, 0, 0	;115
	.db	0, 0, 0, 64, 0, 0, 1, 252, 15, 248, 255, 96, 64, 128, 0, 1, 2, 4, 16, 16, 0, 0, 0, 0, 16, 192, 127, 128, 255, 1, 6, 4, 8, 0, 96, 64, 0, 255, 1, 254, 7, 8, 16, 0, 0, 0	;117
	.db	0, 16, 0, 96, 0, 224, 1, 224, 5, 224, 1, 224, 1, 128, 15, 0, 248, 5, 0, 31, 0, 96, 0, 0, 31, 128, 127, 128, 15, 1, 14, 0, 224, 0, 224, 0, 128, 15, 1, 240, 7, 0, 31, 0, 64, 0	;119
	.db	8, 16, 224, 96, 128, 231, 1, 242, 5, 128, 1, 160, 95, 128, 231, 1, 6, 6, 8, 16, 0, 0, 0, 0, 16, 12, 96, 48, 192, 193, 193, 5, 254, 3, 224, 7, 0, 120, 1, 128, 7, 0, 24, 0, 64, 0	;121
	.db	0, 0, 224, 112, 128, 135, 1, 50, 4, 136, 17, 32, 76, 128, 96, 1, 6, 7, 56, 24, 0, 0, 0, 0, 0, 0, 16, 0, 64, 0, 128, 3, 240, 251, 225, 199, 143, 0, 32, 2, 128, 0, 0, 0, 0, 0	;123
	.db	0, 0, 0, 0, 0, 0, 0, 0, 0, 254, 255, 251, 255, 15, 0, 0, 0, 0, 0, 0, 0, 0, 0, 0, 0, 0, 0, 128, 0, 32, 2, 128, 248, 241, 195, 239, 7, 224, 0, 0, 1, 0, 4, 0, 0, 0	;125
	.db	0, 0, 0, 128, 1, 0, 12, 0, 96, 0, 192, 1, 128, 3, 0, 6, 0, 48, 0, 128, 1, 0, 0, 0, 0, 224, 1, 128, 8, 0, 66, 0, 8, 2, 32, 8, 128, 16, 0, 34, 0, 120, 0, 0, 0, 0	;127
