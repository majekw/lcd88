; font 8x8 rotated
	.db	0, 0, 0, 0, 0, 0, 0, 0 			;32
	.db	0, 0, 96, 250, 250, 96, 0, 0		;33
	.db	0, 192, 224, 0, 0, 224, 192, 0	 	;34
	.db	40, 254, 254, 40, 254, 254, 40, 0 	;35
	.db	0, 36, 116, 214, 214, 92, 72, 0 	;36
	.db	98, 102, 12, 24, 48, 102, 70, 0 	;37
	.db	12, 94, 242, 186, 236, 94, 18, 0 	;38
	.db	0, 0, 32, 224, 192, 0, 0, 0	 	;39
	.db	0, 0, 56, 124, 198, 130, 0, 0	 	;40
	.db	0, 0, 130, 198, 124, 56, 0, 0		;41
	.db	16, 84, 124, 56, 56, 124, 84, 16 	;42
	.db	0, 16, 16, 124, 124, 16, 16, 0		;43
	.db	0, 0, 1, 7, 6, 0, 0, 0			;44
	.db	0, 16, 16, 16, 16, 16, 16, 0		;45
	.db	0, 0, 0, 6, 6, 0, 0, 0			;46
	.db	6, 12, 24, 48, 96, 192, 128, 0		;47
	.db	56, 124, 198, 146, 198, 124, 56, 0	;48
	.db	0, 2, 66, 254, 254, 2, 2, 0		;49
	.db	66, 198, 142, 154, 146, 246, 102, 0	;50
	.db	68, 198, 146, 146, 146, 254, 108, 0	;51
	.db	24, 56, 104, 202, 254, 254, 10, 0	;52
	.db	244, 246, 146, 146, 146, 158, 140, 0	;53
	.db	60, 126, 210, 146, 146, 30, 12, 0	;54
	.db	192, 192, 142, 158, 176, 224, 192, 0	;55
	.db	108, 254, 146, 146, 146, 254, 108, 0	;56
	.db	96, 242, 146, 146, 150, 252, 120, 0	;57
	.db	0, 0, 0, 102, 102, 0, 0, 0		;58
	.db	0, 0, 1, 103, 102, 0, 0, 0		;59
	.db	0, 0, 16, 56, 108, 198, 130, 0		;60
	.db	0, 36, 36, 36, 36, 36, 36, 0		;61
	.db	0, 130, 198, 108, 56, 16, 0, 0		;62
	.db	64, 192, 128, 154, 186, 224, 64, 0	;63
	.db	124, 254, 130, 186, 186, 248, 120, 0	;64
	.db	62, 126, 208, 144, 208, 126, 62, 0	;65
	.db	130, 254, 254, 146, 146, 254, 108, 0	;66
	.db	56, 124, 198, 130, 130, 198, 68, 0	;67
	.db	130, 254, 254, 130, 198, 124, 56, 0	;68
	.db	130, 254, 254, 146, 186, 130, 198, 0	;69
	.db	130, 254, 254, 146, 184, 128, 192, 0	;70
	.db	56, 124, 198, 130, 138, 204, 78, 0	;71
	.db	254, 254, 16, 16, 16, 254, 254, 0	;72
	.db	0, 0, 130, 254, 254, 130, 0, 0		;73
	.db	12, 14, 2, 130, 254, 252, 128, 0	;74
	.db	130, 254, 254, 16, 56, 238, 198, 0	;75
	.db	130, 254, 254, 130, 2, 6, 14, 0		;76
	.db	254, 254, 112, 56, 112, 254, 254, 0	;77
	.db	254, 254, 96, 48, 24, 254, 254, 0	;78
	.db	124, 254, 130, 130, 130, 254, 124, 0	;79
	.db	130, 254, 254, 146, 144, 240, 96, 0	;80
	.db	124, 254, 130, 130, 135, 255, 125, 0	;81
	.db	130, 254, 254, 144, 152, 254, 102, 0	;82
	.db	0, 68, 230, 178, 154, 206, 68, 0	;83
	.db	0, 224, 194, 254, 254, 194, 224, 0	;84
	.db	252, 254, 2, 2, 2, 254, 252, 0		;85
	.db	248, 252, 6, 2, 6, 252, 248, 0		;86
	.db	252, 254, 6, 28, 6, 254, 252, 0		;87
	.db	198, 238, 56, 16, 56, 238, 198, 0	;88
	.db	0, 224, 242, 30, 30, 242, 224, 0	;89
	.db	226, 198, 142, 154, 178, 230, 206, 0	;90
	.db	0, 0, 254, 254, 130, 130, 0, 0		;91
	.db	128, 192, 96, 48, 24, 12, 6, 0		;92
	.db	0, 0, 130, 130, 254, 254, 0, 0		;93
	.db	16, 48, 96, 192, 96, 48, 16, 0		;94
	.db	1, 1, 1, 1, 1, 1, 1, 1			;95
	.db	0, 0, 128, 192, 96, 32, 0, 0		;96
	.db	4, 46, 42, 42, 60, 30, 2, 0		;97
	.db	130, 254, 252, 34, 34, 62, 28, 0	;98
	.db	28, 62, 34, 34, 34, 54, 20, 0		;99
	.db	28, 62, 34, 162, 252, 254, 2, 0		;100
	.db	28, 62, 42, 42, 42, 58, 24, 0		;101
	.db	18, 126, 254, 146, 144, 192, 64, 0	;102
	.db	25, 61, 37, 37, 31, 62, 32, 0		;103
	.db	130, 254, 254, 16, 32, 62, 30, 0	;104
	.db	0, 0, 34, 190, 190, 2, 0, 0		;105
	.db	0, 6, 7, 1, 1, 191, 190, 0		;106
	.db	130, 254, 254, 8, 28, 54, 34, 0		;107
	.db	0, 0, 130, 254, 254, 2, 0, 0		;108
	.db	62, 62, 48, 30, 48, 62, 30, 0		;109
	.db	32, 62, 30, 32, 32, 62, 30, 0		;110
	.db	28, 62, 34, 34, 34, 62, 28, 0		;111
	.db	33, 63, 31, 37, 36, 60, 24, 0		;112
	.db	24, 60, 36, 37, 31, 63, 33, 0		;113
	.db	34, 62, 30, 50, 32, 48, 16, 0		;114
	.db	18, 58, 42, 42, 42, 46, 36, 0		;115
	.db	32, 32, 252, 254, 34, 38, 4, 0		;116
	.db	60, 62, 2, 2, 60, 62, 2, 0		;117
	.db	56, 60, 6, 2, 6, 60, 56, 0		;118
	.db	60, 62, 6, 28, 6, 62, 60, 0		;119
	.db	34, 54, 28, 8, 28, 54, 34, 0		;120
	.db	57, 61, 5, 5, 5, 63, 62, 0		;121
	.db	0, 50, 38, 46, 58, 50, 38, 0		;122
	.db	0, 16, 16, 124, 238, 130, 130, 0	;123
	.db	0, 0, 0, 254, 254, 0, 0, 0		;124
	.db	0, 130, 130, 238, 124, 16, 16, 0	;125
	.db	64, 192, 128, 192, 64, 192, 128, 0	;126
	.db	0, 96, 240, 144, 240, 96, 0, 0		;127
