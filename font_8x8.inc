;****************************************************
;* Font 8x8 from linux kernel                       *
;* /usr/src/linux/drivers/video/console/font_8x8.c  *
;****************************************************

.db 	0x00, 	0x00, 	0x00, 	0x00, 	0x00, 	0x00, 	0x00, 	0x00 	; 32 0x20 ' '
.db	0x18, 	0x3c, 	0x3c, 	0x18, 	0x18, 	0x00, 	0x18, 	0x00 	; 33 0x21 '!'
.db	0x66, 	0x66, 	0x24, 	0x00, 	0x00, 	0x00,	0x00, 	0x00 	; 34 0x22 '"'
.db	0x6c, 	0x6c, 	0xfe, 	0x6c, 	0xfe, 	0x6c, 	0x6c, 	0x00 	; 35 0x23 '#'
.db	0x18, 	0x3e, 	0x60, 	0x3c, 	0x06, 	0x7c, 	0x18, 	0x00 	; 36 0x24 '$'
.db	0x00, 	0xc6, 	0xcc, 	0x18, 	0x30, 	0x66, 	0xc6, 	0x00 	; 37 0x25 '%'
.db	0x38, 	0x6c, 	0x38, 	0x76, 	0xdc, 	0xcc, 	0x76, 	0x00 	; 38 0x26 '&'
.db	0x18, 	0x18, 	0x30, 	0x00, 	0x00, 	0x00, 	0x00, 	0x00 	; 39 0x27 '''
.db	0x0c, 	0x18, 	0x30, 	0x30, 	0x30, 	0x18, 	0x0c, 	0x00 	; 40 0x28 '('
.db	0x30, 	0x18, 	0x0c, 	0x0c, 	0x0c, 	0x18, 	0x30, 	0x00 	; 41 0x29 ')'
.db	0x00, 	0x66, 	0x3c, 	0xff, 	0x3c, 	0x66, 	0x00, 	0x00 	; 42 0x2a '*'
.db	0x00, 	0x18, 	0x18, 	0x7e, 	0x18, 	0x18, 	0x00, 	0x00 	; 43 0x2b '+'
.db	0x00, 	0x00, 	0x00, 	0x00, 	0x00, 	0x18, 	0x18, 	0x30 	; 44 0x2c ','
.db	0x00, 	0x00, 	0x00, 	0x7e, 	0x00, 	0x00, 	0x00, 	0x00 	; 45 0x2d '-'
.db	0x00, 	0x00, 	0x00, 	0x00, 	0x00, 	0x18, 	0x18, 	0x00 	; 46 0x2e '.'
.db	0x06, 	0x0c, 	0x18, 	0x30, 	0x60, 	0xc0, 	0x80, 	0x00 	; 47 0x2f '/'
.db	0x38, 	0x6c, 	0xc6, 	0xd6, 	0xc6, 	0x6c, 	0x38, 	0x00 	; 48 0x30 '0'
.db	0x18, 	0x38, 	0x18, 	0x18, 	0x18, 	0x18, 	0x7e, 	0x00 	; 49 0x31 '1'
.db	0x7c, 	0xc6, 	0x06, 	0x1c, 	0x30, 	0x66, 	0xfe, 	0x00 	; 50 0x32 '2'
.db	0x7c, 	0xc6, 	0x06, 	0x3c, 	0x06, 	0xc6, 	0x7c, 	0x00 	; 51 0x33 '3'
.db	0x1c, 	0x3c, 	0x6c, 	0xcc, 	0xfe, 	0x0c, 	0x1e, 	0x00 	; 52 0x34 '4'
.db	0xfe, 	0xc0, 	0xc0, 	0xfc, 	0x06, 	0xc6, 	0x7c, 	0x00 	; 53 0x35 '5'
.db	0x38, 	0x60, 	0xc0, 	0xfc, 	0xc6, 	0xc6, 	0x7c, 	0x00 	; 54 0x36 '6'
.db	0xfe, 	0xc6, 	0x0c, 	0x18, 	0x30, 	0x30, 	0x30, 	0x00 	; 55 0x37 '7'
.db	0x7c, 	0xc6, 	0xc6, 	0x7c, 	0xc6, 	0xc6, 	0x7c, 	0x00 	; 56 0x38 '8'
.db	0x7c, 	0xc6, 	0xc6, 	0x7e, 	0x06, 	0x0c, 	0x78, 	0x00 	; 57 0x39 '9'
.db	0x00, 	0x18, 	0x18, 	0x00, 	0x00, 	0x18, 	0x18, 	0x00 	; 58 0x3a ':'
.db	0x00, 	0x18, 	0x18, 	0x00, 	0x00, 	0x18, 	0x18, 	0x30 	; 59 0x3b ';'
.db	0x06, 	0x0c, 	0x18, 	0x30, 	0x18, 	0x0c, 	0x06, 	0x00 	; 60 0x3c '<'
.db	0x00, 	0x00, 	0x7e, 	0x00, 	0x00, 	0x7e, 	0x00, 	0x00 	; 61 0x3d '='
.db	0x60, 	0x30, 	0x18, 	0x0c, 	0x18, 	0x30, 	0x60, 	0x00 	; 62 0x3e '>'
.db	0x7c, 	0xc6, 	0x0c, 	0x18, 	0x18, 	0x00, 	0x18, 	0x00 	; 63 0x3f '?'
.db	0x7c, 	0xc6, 	0xde, 	0xde, 	0xde, 	0xc0, 	0x78, 	0x00 	; 64 0x40 '@'
.db	0x38, 	0x6c, 	0xc6, 	0xfe, 	0xc6, 	0xc6, 	0xc6, 	0x00 	; 65 0x41 'A'
.db	0xfc, 	0x66, 	0x66, 	0x7c, 	0x66, 	0x66, 	0xfc, 	0x00 	; 66 0x42 'B'
.db	0x3c, 	0x66, 	0xc0, 	0xc0, 	0xc0, 	0x66, 	0x3c, 	0x00 	; 67 0x43 'C'
.db	0xf8, 	0x6c, 	0x66, 	0x66, 	0x66, 	0x6c, 	0xf8, 	0x00 	; 68 0x44 'D'
.db	0xfe, 	0x62, 	0x68, 	0x78, 	0x68, 	0x62, 	0xfe, 	0x00 	; 69 0x45 'E'
.db	0xfe, 	0x62, 	0x68, 	0x78, 	0x68, 	0x60, 	0xf0, 	0x00 	; 70 0x46 'F'
.db	0x3c, 	0x66, 	0xc0, 	0xc0, 	0xce, 	0x66, 	0x3a, 	0x00 	; 71 0x47 'G'
.db	0xc6, 	0xc6, 	0xc6, 	0xfe, 	0xc6, 	0xc6, 	0xc6, 	0x00 	; 72 0x48 'H'
.db	0x3c, 	0x18, 	0x18, 	0x18, 	0x18, 	0x18, 	0x3c, 	0x00 	; 73 0x49 'I'
.db	0x1e, 	0x0c, 	0x0c, 	0x0c, 	0xcc, 	0xcc, 	0x78, 	0x00 	; 74 0x4a 'J'
.db	0xe6, 	0x66, 	0x6c, 	0x78, 	0x6c, 	0x66, 	0xe6, 	0x00 	; 75 0x4b 'K'
.db	0xf0, 	0x60, 	0x60, 	0x60, 	0x62, 	0x66, 	0xfe, 	0x00 	; 76 0x4c 'L'
.db	0xc6, 	0xee, 	0xfe, 	0xfe, 	0xd6, 	0xc6, 	0xc6, 	0x00 	; 77 0x4d 'M'
.db	0xc6, 	0xe6, 	0xf6, 	0xde, 	0xce, 	0xc6, 	0xc6, 	0x00 	; 78 0x4e 'N'
.db	0x7c, 	0xc6, 	0xc6, 	0xc6, 	0xc6, 	0xc6, 	0x7c, 	0x00 	; 79 0x4f 'O'
.db	0xfc, 	0x66, 	0x66, 	0x7c, 	0x60, 	0x60, 	0xf0, 	0x00 	; 80 0x50 'P'
.db	0x7c, 	0xc6, 	0xc6, 	0xc6, 	0xc6, 	0xce, 	0x7c, 	0x0e 	; 81 0x51 'Q'
.db	0xfc, 	0x66, 	0x66, 	0x7c, 	0x6c, 	0x66, 	0xe6, 	0x00 	; 82 0x52 'R'
.db	0x3c, 	0x66, 	0x30, 	0x18, 	0x0c, 	0x66, 	0x3c, 	0x00 	; 83 0x53 'S'
.db	0x7e, 	0x7e, 	0x5a, 	0x18, 	0x18, 	0x18, 	0x3c, 	0x00 	; 84 0x54 'T'
.db	0xc6, 	0xc6, 	0xc6, 	0xc6, 	0xc6, 	0xc6, 	0x7c, 	0x00 	; 85 0x55 'U'
.db	0xc6, 	0xc6, 	0xc6, 	0xc6, 	0xc6, 	0x6c, 	0x38, 	0x00 	; 86 0x56 'V'
.db	0xc6, 	0xc6, 	0xc6, 	0xd6, 	0xd6, 	0xfe, 	0x6c, 	0x00 	; 87 0x57 'W'
.db	0xc6, 	0xc6, 	0x6c, 	0x38, 	0x6c, 	0xc6, 	0xc6, 	0x00 	; 88 0x58 'X'
.db	0x66, 	0x66, 	0x66, 	0x3c, 	0x18, 	0x18, 	0x3c, 	0x00 	; 89 0x59 'Y'
.db	0xfe, 	0xc6, 	0x8c, 	0x18, 	0x32, 	0x66, 	0xfe, 	0x00 	; 90 0x5a 'Z'
.db	0x3c, 	0x30, 	0x30, 	0x30, 	0x30, 	0x30, 	0x3c, 	0x00 	; 91 0x5b '['
.db	0xc0, 	0x60, 	0x30, 	0x18, 	0x0c, 	0x06, 	0x02, 	0x00 	; 92 0x5c '\'
.db	0x3c, 	0x0c, 	0x0c, 	0x0c, 	0x0c, 	0x0c, 	0x3c, 	0x00 	; 93 0x5d ']'
.db	0x10, 	0x38, 	0x6c, 	0xc6, 	0x00, 	0x00, 	0x00, 	0x00 	; 94 0x5e '^'
.db	0x00, 	0x00, 	0x00, 	0x00, 	0x00, 	0x00, 	0x00, 	0xff 	; 95 0x5f '_'
.db	0x30, 	0x18, 	0x0c, 	0x00, 	0x00, 	0x00, 	0x00, 	0x00 	; 96 0x60 '`'
.db	0x00, 	0x00, 	0x78, 	0x0c, 	0x7c, 	0xcc, 	0x76, 	0x00 	; 97 0x61 'a'
.db	0xe0, 	0x60, 	0x7c, 	0x66, 	0x66, 	0x66, 	0xdc, 	0x00 	; 98 0x62 'b'
.db	0x00, 	0x00, 	0x7c, 	0xc6, 	0xc0, 	0xc6, 	0x7c, 	0x00 	; 99 0x63 'c'
.db	0x1c, 	0x0c, 	0x7c, 	0xcc, 	0xcc, 	0xcc, 	0x76, 	0x00 	; 100 0x64 'd'
.db	0x00, 	0x00, 	0x7c, 	0xc6, 	0xfe, 	0xc0, 	0x7c, 	0x00 	; 101 0x65 'e'
.db	0x3c, 	0x66, 	0x60, 	0xf8, 	0x60, 	0x60, 	0xf0, 	0x00 	; 102 0x66 'f'
.db	0x00, 	0x00, 	0x76, 	0xcc, 	0xcc, 	0x7c, 	0x0c, 	0xf8 	; 103 0x67 'g'
.db	0xe0, 	0x60, 	0x6c, 	0x76, 	0x66, 	0x66, 	0xe6, 	0x00 	; 104 0x68 'h'
.db	0x18, 	0x00, 	0x38, 	0x18, 	0x18, 	0x18, 	0x3c, 	0x00 	; 105 0x69 'i'
.db	0x06, 	0x00, 	0x06, 	0x06, 	0x06, 	0x66, 	0x66, 	0x3c 	; 106 0x6a 'j'
.db	0xe0, 	0x60, 	0x66, 	0x6c, 	0x78, 	0x6c, 	0xe6, 	0x00 	; 107 0x6b 'k'
.db	0x38, 	0x18, 	0x18, 	0x18, 	0x18, 	0x18, 	0x3c, 	0x00 	; 108 0x6c 'l'
.db	0x00, 	0x00, 	0xec, 	0xfe, 	0xd6, 	0xd6, 	0xd6, 	0x00 	; 109 0x6d 'm'
.db	0x00, 	0x00, 	0xdc, 	0x66, 	0x66, 	0x66, 	0x66, 	0x00 	; 110 0x6e 'n'
.db	0x00, 	0x00, 	0x7c, 	0xc6, 	0xc6, 	0xc6, 	0x7c, 	0x00 	; 111 0x6f 'o'
.db	0x00, 	0x00, 	0xdc, 	0x66, 	0x66, 	0x7c, 	0x60, 	0xf0 	; 112 0x70 'p'
.db	0x00, 	0x00, 	0x76, 	0xcc, 	0xcc, 	0x7c, 	0x0c, 	0x1e 	; 113 0x71 'q'
.db	0x00, 	0x00, 	0xdc, 	0x76, 	0x60, 	0x60, 	0xf0, 	0x00 	; 114 0x72 'r'
.db	0x00, 	0x00, 	0x7e, 	0xc0, 	0x7c, 	0x06, 	0xfc, 	0x00 	; 115 0x73 's'
.db	0x30, 	0x30, 	0xfc, 	0x30, 	0x30, 	0x36, 	0x1c, 	0x00 	; 116 0x74 't'
.db	0x00, 	0x00, 	0xcc, 	0xcc, 	0xcc, 	0xcc, 	0x76, 	0x00 	; 117 0x75 'u'
.db	0x00, 	0x00, 	0xc6, 	0xc6, 	0xc6, 	0x6c, 	0x38, 	0x00 	; 118 0x76 'v'
.db	0x00, 	0x00, 	0xc6, 	0xd6, 	0xd6, 	0xfe, 	0x6c, 	0x00 	; 119 0x77 'w'
.db	0x00, 	0x00, 	0xc6, 	0x6c, 	0x38, 	0x6c, 	0xc6, 	0x00 	; 120 0x78 'x'
.db	0x00, 	0x00, 	0xc6, 	0xc6, 	0xc6, 	0x7e, 	0x06, 	0xfc 	; 121 0x79 'y'
.db	0x00, 	0x00, 	0x7e, 	0x4c, 	0x18, 	0x32, 	0x7e, 	0x00 	; 122 0x7a 'z'
.db	0x0e, 	0x18, 	0x18, 	0x70, 	0x18, 	0x18, 	0x0e, 	0x00 	; 123 0x7b '{'
.db	0x18, 	0x18, 	0x18, 	0x18, 	0x18, 	0x18, 	0x18, 	0x00 	; 124 0x7c '|'
.db	0x70, 	0x18, 	0x18, 	0x0e, 	0x18, 	0x18, 	0x70, 	0x00 	; 125 0x7d '}'
.db	0x76, 	0xdc, 	0x00, 	0x00, 	0x00, 	0x00, 	0x00, 	0x00 	; 126 0x7e '~'
;.db	0x00, 	0x10, 	0x38, 	0x6c, 	0xc6, 	0xc6, 	0xfe, 	0x00 	; 127 0x7f ''
.db     0x38,	0x6c,	0x6c,	0x38,	0x00,	0x00,	0x00,	0x00	; 248 0xf8 'o^'
