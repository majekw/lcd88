; Include file generated from bootloader.lst dated Sun Mar  3 01:30:18 CET 2013
.cseg
.org	0x003f00
boot_start:

.org	0x003f22
boot_wait:

.org	0x003f26
boot_menu:

.org	0x003f29
boot_menu1:

.org	0x003f31
boot_firmware:

.org	0x003f34
xmodem_start:

.org	0x003f35
xmodem_start1:

.org	0x003f3e
xmodem_receive:

.org	0x003f46
xmodem_receive1:

.org	0x003f5a
xmodem_end:

.org	0x003f5d
boot_end:

.org	0x003f63
boot_print:

.org	0x003f68
boot_print1:

.org	0x003f69
boot_tx_char:

.org	0x003f70
boot_rx_char:

.org	0x003f74
boot_rx_char1:

.org	0x003f7e
boot_rx_char2:

.org	0x003f81
boot_rx_char3:

.org	0x003f83
boot_block_write:

.org	0x003f83
boot_fill_page:

.org	0x003f84
boot_fill_page1:

.org	0x003f8e
boot_erase_page:

.org	0x003f90
boot_write_page:

.org	0x003f9b
boot_spm:

.org	0x003FA1
boot_banner1:

.org	0x003FCE
boot_banner2:

.org	0x003FD5
boot_banner3:

