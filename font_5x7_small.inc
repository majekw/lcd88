	.db	0, 0, 0, 0, 0, 0, 64, 30, 0, 0	;32,33
	.db	0, 56, 0, 14, 0, 148, 63, 229, 79, 1	;35
	.db	18, 213, 95, 69, 2, 98, 50, 98, 50, 2	;37
	.db	182, 100, 85, 84, 0, 0, 40, 24, 0, 0	;39
	.db	0, 142, 40, 8, 0, 128, 160, 136, 3, 0	;41
	.db	20, 132, 15, 65, 1, 8, 132, 15, 129, 0	;43
	.db	128, 130, 1, 0, 0, 8, 4, 2, 129, 0	;45
	.db	128, 193, 0, 0, 0, 2, 2, 2, 2, 2	;47
	.db	190, 98, 50, 234, 3, 128, 208, 63, 0, 0	;49
	.db	161, 97, 49, 25, 3, 194, 96, 52, 109, 4	;51
	.db	12, 10, 233, 79, 0, 242, 104, 52, 234, 4	;53
	.db	158, 84, 50, 105, 0, 192, 35, 18, 10, 6	;55
	.db	182, 100, 50, 105, 3, 176, 100, 82, 201, 3	;57
	.db	0, 155, 13, 0, 0, 128, 154, 13, 0, 0	;59
	.db	8, 138, 40, 8, 0, 20, 10, 133, 66, 1	;61
	.db	128, 160, 136, 130, 0, 32, 96, 17, 9, 3	;63
	.db	166, 228, 51, 232, 3, 63, 34, 145, 248, 3	;65
	.db	255, 100, 50, 105, 3, 255, 96, 48, 40, 2	;67
	.db	255, 96, 80, 196, 1, 255, 100, 50, 25, 4	;69
	.db	127, 36, 18, 9, 4, 190, 96, 50, 249, 2	;71
	.db	127, 4, 2, 241, 7, 128, 224, 63, 8, 0	;73
	.db	130, 64, 208, 15, 4, 127, 4, 69, 20, 4	;75
	.db	255, 64, 32, 16, 0, 127, 16, 6, 244, 7	;77
	.db	127, 8, 130, 240, 7, 190, 96, 48, 232, 3	;79
	.db	127, 36, 18, 9, 3, 190, 96, 81, 216, 3	;81
	.db	127, 36, 83, 25, 3, 177, 100, 50, 105, 4	;83
	.db	64, 224, 31, 8, 4, 254, 64, 32, 224, 7	;85
	.db	124, 65, 64, 192, 7, 254, 128, 33, 224, 7	;87
	.db	99, 10, 130, 50, 6, 112, 196, 1, 1, 7	;89
	.db	195, 98, 50, 26, 6, 128, 127, 48, 8, 0	;91
	.db	32, 8, 130, 32, 0, 128, 96, 240, 15, 0	;93
	.db	16, 16, 16, 4, 1, 129, 64, 32, 16, 0	;95
	.db	0, 32, 8, 2, 0, 130, 74, 165, 242, 0	;97
	.db	255, 68, 36, 226, 0, 142, 72, 36, 34, 0	;99
	.db	142, 72, 36, 241, 7, 142, 74, 165, 194, 0	;101
	.db	136, 31, 18, 8, 2, 152, 82, 169, 228, 3	;103
	.db	127, 4, 4, 242, 0, 128, 200, 55, 0, 0	;105
	.db	130, 64, 196, 11, 0, 127, 130, 34, 2, 0	;107
	.db	128, 224, 63, 0, 0, 31, 8, 3, 242, 0	;109
	.db	31, 4, 4, 242, 0, 142, 72, 36, 226, 0	;111
	.db	31, 10, 133, 130, 0, 8, 10, 133, 241, 1	;113
	.db	31, 4, 4, 130, 0, 137, 74, 165, 34, 0	;115
	.db	16, 127, 36, 32, 0, 158, 64, 64, 240, 1	;117
	.db	28, 65, 64, 192, 1, 158, 128, 33, 224, 1	;119
	.db	17, 5, 65, 17, 1, 152, 66, 161, 224, 1	;121
	.db	145, 73, 37, 19, 1, 0, 132, 45, 8, 0	;123
	.db	0, 192, 31, 0, 0, 128, 160, 13, 1, 0	;125
	.db	8, 132, 138, 131, 0, 8, 142, 10, 129, 0	;127
